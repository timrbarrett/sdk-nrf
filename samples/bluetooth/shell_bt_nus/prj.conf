## CMakeLists.txt
```
#
# Copyright (c) 2018 Nordic Semiconductor
#
# SPDX-License-Identifier: LicenseRef-Nordic-5-Clause
#
cmake_minimum_required(VERSION 3.20.0)

find_package(Zephyr REQUIRED HINTS $ENV{ZEPHYR_BASE})
project(NONE)

# NORDIC SDK APP START
target_sources(app PRIVATE
  src/main.c
  src/idle_time.h  # Add this line to include your new source file
)

target_include_directories(app PRIVATE .)
# NORDIC SDK APP END

## AD5254 driver
zephyr_library()
zephyr_library_sources_ifdef(
  CONFIG_AD5254
  ad5254.c
  #ad5254.h
)
zephyr_include_directories(.)
```

## prj.conf
```kconfig
#
# Copyright (c) 2018 Nordic Semiconductor
#
# SPDX-License-Identifier: LicenseRef-Nordic-5-Clause
#
CONFIG_NCS_SAMPLES_DEFAULTS=y

CONFIG_HEAP_MEM_POOL_SIZE=2048

CONFIG_BT=y
CONFIG_BT_SMP=y
CONFIG_BT_PERIPHERAL=y
CONFIG_BT_DEVICE_NAME="BT_NUS_shell"
CONFIG_BT_DEVICE_APPEARANCE=833
CONFIG_BT_MAX_CONN=2
CONFIG_BT_MAX_PAIRED=2

# Enable the BT NUS shell
CONFIG_SHELL_BT_NUS=y

CONFIG_SHELL_BT_NUS_LOG_LEVEL_DBG=y

## logging CPU usage
# Nordic case id: 257965
# https://devzone.nordicsemi.com/f/nordic-q-a/67059/zephyr-ram-flash-cpu-usage

# Enable CPU tracing
CONFIG_CPU_LOAD=y
CONFIG_CPU_LOAD_LOG_INTERVAL=2000
CONFIG_CPU_LOAD_LOG_PERIODIC=y

## end logging CPU usage

## enable printk
# https://docs.zephyrproject.org/2.7.5/reference/kconfig/CONFIG_PRINTK.html

CONFIG_PRINTK=y

## end enable printk
```

## src/main.c
```c
/*
 * Copyright (c) 2019 Nordic Semiconductor ASA
 *
 * SPDX-License-Identifier: LicenseRef-Nordic-5-Clause
 */

/** @file
 *  @brief Nordic UART Bridge Service (NUS) sample
 */

#include <zephyr/kernel.h>
#include <zephyr/bluetooth/bluetooth.h>
#include <zephyr/bluetooth/uuid.h>
#include <zephyr/bluetooth/gatt.h>
#include <zephyr/bluetooth/hci.h>
#include <bluetooth/services/nus.h>
#include <zephyr/logging/log.h>
#include <shell/shell_bt_nus.h>
#include <stdio.h>

#include <debug/cpu_load.h>

LOG_MODULE_REGISTER(app);

#define DEVICE_NAME             CONFIG_BT_DEVICE_NAME
#define DEVICE_NAME_LEN	        (sizeof(DEVICE_NAME) - 1)


static struct bt_conn *current_conn;

static const struct bt_data ad[] = {
	BT_DATA_BYTES(BT_DATA_FLAGS, (BT_LE_AD_GENERAL | BT_LE_AD_NO_BREDR)),
	BT_DATA(BT_DATA_NAME_COMPLETE, DEVICE_NAME, DEVICE_NAME_LEN),
};

static const struct bt_data sd[] = {
	BT_DATA_BYTES(BT_DATA_UUID128_ALL, BT_UUID_NUS_VAL),
};

static void connected(struct bt_conn *conn, uint8_t err)
{
	if (err) {
		LOG_ERR("Connection failed (err %u)", err);
		return;
	}

	LOG_INF("Connected");
	current_conn = bt_conn_ref(conn);
	shell_bt_nus_enable(conn);
}

static void disconnected(struct bt_conn *conn, uint8_t reason)
{
	LOG_INF("Disconnected (reason %u)", reason);

	shell_bt_nus_disable();
	if (current_conn) {
		bt_conn_unref(current_conn);
		current_conn = NULL;
	}
}

static char *log_addr(struct bt_conn *conn)
{
	static char addr[BT_ADDR_LE_STR_LEN];

	bt_addr_le_to_str(bt_conn_get_dst(conn), addr, sizeof(addr));

	return addr;
}

static void __attribute__((unused)) security_changed(struct bt_conn *conn,
						     bt_security_t level,
						     enum bt_security_err err)
{
	char *addr = log_addr(conn);

	if (!err) {
		LOG_INF("Security changed: %s level %u", addr, level);
	} else {
		LOG_INF("Security failed: %s level %u err %d", addr, level,
			err);
	}
}

BT_CONN_CB_DEFINE(conn_callbacks) = {
	.connected    = connected,
	.disconnected = disconnected,
	COND_CODE_1(CONFIG_BT_SMP,
		    (.security_changed = security_changed), ())
};

static void auth_passkey_display(struct bt_conn *conn, unsigned int passkey)
{
	LOG_INF("Passkey for %s: %06u", log_addr(conn), passkey);
}

static void auth_cancel(struct bt_conn *conn)
{
	LOG_INF("Pairing cancelled: %s", log_addr(conn));
}

static void pairing_complete(struct bt_conn *conn, bool bonded)
{
	LOG_INF("Pairing completed: %s, bonded: %d", log_addr(conn), bonded);
}

static void pairing_failed(struct bt_conn *conn, enum bt_security_err reason)
{
	LOG_INF("Pairing failed conn: %s, reason %d", log_addr(conn), reason);
}

static struct bt_conn_auth_cb conn_auth_callbacks = {
	.passkey_display = auth_passkey_display,
	.cancel = auth_cancel,
};

static struct bt_conn_auth_info_cb conn_auth_info_callbacks = {
	.pairing_complete = pairing_complete,
	.pairing_failed = pairing_failed
};

int main(void)
{
	int err;

	err=cpu_load_init();
	if(err) {
		printk("Failed to initialize CPU load module (err: %d)\n", err);
		return 0;
	}
	
	printk("Starting Bluetooth NUS shell transport example\n");

	if (IS_ENABLED(CONFIG_BT_SMP)) {
		err = bt_conn_auth_cb_register(&conn_auth_callbacks);
		if (err) {
			printk("Failed to register authorization callbacks.\n");
			return 0;
		}

		err = bt_conn_auth_info_cb_register(&conn_auth_info_callbacks);
		if (err) {
			printk("Failed to register authorization info callbacks.\n");
			return 0;
		}
	}

	err = bt_enable(NULL);
	if (err) {
		LOG_ERR("BLE enable failed (err: %d)", err);
		return 0;
	}

	err = shell_bt_nus_init();
	if (err) {
		LOG_ERR("Failed to initialize BT NUS shell (err: %d)", err);
		return 0;
	}

	err = bt_le_adv_start(BT_LE_ADV_CONN, ad, ARRAY_SIZE(ad), sd,
			      ARRAY_SIZE(sd));
	if (err) {
		LOG_ERR("Advertising failed to start (err %d)", err);
		return 0;
	}

	LOG_INF("Bluetooth ready. Advertising started.");

	return 0;
}
```

## src/idle_time.h
```c
/*
    Code generated by Chat GPT 
    https://chat.openai.com/c/f26b5141-1e64-42b4-8dcb-dff62c575706

    intention is to baseline how many idle cycles are possible in a given time frame
    to understand how many CPU cycles are being consumed by the system providing
    shells and bluetooth services

    now I need to figure out how to add this file to cmake and build it

    also:-
    Enable System Idle Hook: First, ensure that the system idle hook 
    is enabled in your Zephyr application. This can be done by setting 
    CONFIG_PM=y and CONFIG_PM_DEVICE=y in your prj.conf file to enable 
    power management and the system idle thread.

    Use the System Idle Hook: Implement a function that will be called 
    by the system idle thread. Within this function, you can capture the 
    current tick count. You might also need to store the tick count when 
    the system exits idle mode to calculate the difference.

    Calculate Idle Ticks: By subtracting the tick count at the entry of 
    idle mode from the tick count at the exit, you can determine how many 
    ticks the system spent in idle mode.

*/

#include <zephyr/kernel.h>
#include <zephyr/sys/printk.h>

static uint32_t last_tick;
static uint32_t total_idle_ticks = 0;

/* Idle hook function, called each time the kernel enters the idle loop */
void idle_hook(void)
{
    uint32_t current_tick = k_uptime_get_32();

    if (last_tick != 0) {
        uint32_t idle_ticks = current_tick - last_tick;
        total_idle_ticks += idle_ticks;
    }

    last_tick = current_tick;
}

/* Main function moved to actual main section in main.c*/
//void main(void)
//{
//    /* Set the idle hook */
//    k_idle_hook_install(idle_hook);
//
//    while (1) {
//        k_sleep(K_SECONDS(1)); // Sleep to simulate work
//
//        printk("Total Idle Ticks in Last Second: %u\n", total_idle_ticks);
//        total_idle_ticks = 0; // Reset the counter after reporting
//    }
//}
```
